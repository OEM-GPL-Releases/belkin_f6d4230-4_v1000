## F6D4230v1-1.00.03-GPL/GPL_src_code/firmware/linux-2.6.21.x/ralink/Kconfig
```kconfig
menu "Ralink Module"

source "drivers/net/rt_rdm/Kconfig"
#source "drivers/net/wireless/iNIC/Kconfig"
source "drivers/usb/dwc_otg/Kconfig"

#choice
#prompt "Ralink NAT Type"
	
#config  RA_NAT_NONE
#bool "None"
#config  RA_NAT_HW
#bool "Hardware"
#endchoice

#source "net/nat/hw_nat/Kconfig"

endmenu
```
